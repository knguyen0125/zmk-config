## config/boards/shields/corne_choc_xiao/Kconfig.defconfig
```kconfig
if SHIELD_CORNE_CHOC_XIAO_DONGLE || SHIELD_CORNE_CHOC_XIAO_LEFT_CENTRAL || SHIELD_CORNE_CHOC_XIAO_RIGHT_CENTRAL

config ZMK_KEYBOARD_NAME
    default "Corne-xiao"

config ZMK_SPLIT_ROLE_CENTRAL
    default y

endif

if SHIELD_CORNE_CHOC_XIAO_DONGLE

config ZMK_SPLIT_BLE_CENTRAL_PERIPHERALS
	default 2

config BT_MAX_PAIRED
	default 7

config BT_MAX_CONN
	default 7

endif

if SHIELD_CORNE_CHOC_XIAO_LEFT_SINGLE || SHIELD_CORNE_CHOC_XIAO_RIGHT_SINGLE || SHIELD_CORNE_CHOC_XIAO_DONGLE || SHIELD_CORNE_CHOC_XIAO_LEFT_CENTRAL || SHIELD_CORNE_CHOC_XIAO_RIGHT_CENTRAL

config ZMK_SPLIT
    default y

config ZMK_BLE
    default y

config ZMK_USB
    default y
endif
```

## config/boards/shields/corne_choc_xiao/Kconfig.shield
```kconfig
config SHIELD_CORNE_CHOC_XIAO_LEFT_SINGLE
    def_bool $(shields_list_contains,corne_choc_xiao_left_single)

config SHIELD_CORNE_CHOC_XIAO_LEFT_CENTRAL
    def_bool $(shields_list_contains,corne_choc_xiao_left_central)

config SHIELD_CORNE_CHOC_XIAO_RIGHT_SINGLE
    def_bool $(shields_list_contains,corne_choc_xiao_right_single)

config SHIELD_CORNE_CHOC_XIAO_RIGHT_CENTRAL
    def_bool $(shields_list_contains,corne_choc_xiao_right_central)
    
config SHIELD_CORNE_CHOC_XIAO_DONGLE
    def_bool $(shields_list_contains,corne_choc_xiao_dongle)
```
